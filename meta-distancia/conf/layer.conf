## meta-distancia/conf/layer.conf
```bitbake
# We have a conf and classes directory, add to BBPATH
BBPATH .= ":${LAYERDIR}"

# We have recipes-* directories, add to BBFILES
BBFILES += "${LAYERDIR}/recipes-*/*.bb \
            ${LAYERDIR}/recipes-*/*/*.bbappend"

BBFILE_COLLECTIONS += "distancia"
BBFILE_PATTERN_distancia = "^${LAYERDIR}/"
BBFILE_PRIORITY_distancia = "5"
LAYERVERSION_distancia = "4"
LAYERSERIES_COMPAT_distancia = "warrior"
```

## pro3/conf/bblayers.conf
```bitbake
# POKY_BBLAYERS_CONF_VERSION is increased each time build/conf/bblayers.conf
# changes incompatibly
POKY_BBLAYERS_CONF_VERSION = "2"

BBPATH = "${TOPDIR}"
BBFILES ?= ""

BBLAYERS ?= " \
  /home/kendal/Documents/poky-warrior/meta \
  /home/kendal/Documents/poky-warrior/meta-poky \
  /home/kendal/Documents/poky-warrior/meta-yocto-bsp \
  /home/kendal/Documents/poky-warrior/meta-raspberrypi \
  /home/kendal/Documents/poky-warrior/meta-openembedded/meta-oe \
  /home/kendal/Documents/poky-warrior/meta-openembedded/meta-multimedia \
  /home/kendal/Documents/poky-warrior/meta-openembedded/meta-networking \
  /home/kendal/Documents/poky-warrior/meta-openembedded/meta-python \
  /home/kendal/Documents/poky-warrior/meta-distancia \
  "
```
